## Config.in
```kconfig
# Add project-specific packages for Buildroot here
#
# If these are non-proprietary, please consider contributing them back to
# Nerves or Buildroot.

# Load external packages
source "$NERVES_DEFCONFIG_DIR/packages/frpc/Config.in"
source "$NERVES_DEFCONFIG_DIR/packages/etherlab/Config.in"
source "$NERVES_DEFCONFIG_DIR/packages/atemsys/Config.in"
source "$NERVES_DEFCONFIG_DIR/packages/soem/Config.in"
```

## packages/cloudflared-bin/Config.in
```kconfig
config BR2_PACKAGE_CLOUDFLARED_BIN
    bool "cloudflared-bin"
    help
      Argo Tunnel client (precompilated for armv6).

      https://github.com/cloudflare/cloudflared
```

## packages/cloudflared/Config.in
```kconfig
config BR2_PACKAGE_CLOUDFLARED
    bool "cloudflared"
    help
      Argo Tunnel client (precompilated for armv6).

      https://github.com/cloudflare/cloudflared
```

## packages/frpc/Config.in
```kconfig
config BR2_PACKAGE_FRPC
    bool "frpc"
    help
      A FRP client for ARM's (precompilated).

      https://github.com/fatedier/frp
```

## packages/soem/Config.in
```kconfig
config BR2_PACKAGE_SOEM
    bool "soem"
    help
      Simple Open Source EtherCAT Master.

      https://github.com/OpenEtherCATsociety/SOEM
```
